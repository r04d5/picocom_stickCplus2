## sdkconfig.defaults
```kconfig
# ESP-IDF Configuration Defaults for M5StickC Plus2
CONFIG_ESPTOOLPY_FLASHSIZE_8MB=y
CONFIG_ESPTOOLPY_FLASHSIZE="8MB"
CONFIG_MONITOR_BAUD=115200
CONFIG_ESP_CONSOLE_UART_BAUDRATE=115200
# Enable C++ exceptions (M5Unified / LovyanGFX uses them in some places)
CONFIG_COMPILER_CXX_EXCEPTIONS=y
```
